## kernel/actiondfs/Kconfig
```kconfig
config ACTIONDFS_FS
	bool "actiond manifest filesystems"
	help
	  Action input manifest filesystems used by actiond VM workers. The
	  normal actiondfs filesystem maps manifest paths to immutable CAS blobs
	  with stats compiled out. The actiondfs_instrumented sibling builds the
	  same implementation with profiling counters enabled.
```
